## components/airplay_options/Kconfig.projbuild
```kconfig
menu "Surround Build Role"
    choice AIRPLAY_BUILD_ROLE
        prompt "Firmware role"
        default AIRPLAY_ROLE_SPEAKER
        help
            Set by the project folder, leave it: the repository folder
            builds the Gateway (sdkconfig.defaults.gateway), speaker/ the
            speakers.
            Gateway: the AirPlay receiver the Apple TV plays to (mDNS,
            pairing, RTSP, PTP), without a decoder or I2S output; a proxy
            forwards every sound_engine call and the raw audio stream to
            the speakers.
            Speaker: follows the Gateway and plays one channel through I2S;
            not an AirPlay receiver of its own.
        config AIRPLAY_ROLE_SPEAKER
            bool "Speaker (follows the Gateway, I2S output)"
        config AIRPLAY_ROLE_GATEWAY
            bool "Gateway (AirPlay front end, no audio output)"
    endchoice

    choice AIRPLAY_GATEWAY_BOARD
        prompt "Gateway board"
        depends on AIRPLAY_ROLE_GATEWAY
        default AIRPLAY_GW_BOARD_S3_DEVKIT if IDF_TARGET_ESP32S3
        default AIRPLAY_GW_BOARD_FIREBEETLE_P4 if IDF_TARGET_ESP32P4
        default AIRPLAY_GW_BOARD_CUSTOM
        help
            The board the Gateway runs on; it sets the default pins below
            (they can still be changed one by one). Only the boards of the
            current target are listed (idf.py set-target esp32s3 or
            esp32p4). Custom keeps the defaults of the target's board.
        config AIRPLAY_GW_BOARD_S3_DEVKIT
            bool "ESP32-S3 DevKit N8R8"
            depends on IDF_TARGET_ESP32S3
        config AIRPLAY_GW_BOARD_FIREBEETLE_P4
            bool "DFRobot FireBeetle 2 ESP32-P4 (Wi-Fi through its ESP32-C6)"
            depends on IDF_TARGET_ESP32P4
        config AIRPLAY_GW_BOARD_CUSTOM
            bool "Custom"
    endchoice

    config AIRPLAY_GW_TIME_PULSE_GPIO
        int "Time pulse from the C6 (P4 GPIO)"
        default 6
        range 0 SOC_GPIO_IN_RANGE_MAX
        depends on AIRPLAY_ROLE_GATEWAY && IDF_TARGET_ESP32P4
        help
            The line on which the C6 co-processor sends its time pulse
            (the WAKEUP line of ESP-Hosted; 6 on the FireBeetle 2). The C6
            side is GW_C6_WAKEUP_GPIO of the C6 firmware (coprocessor/c6,
            default 2); a board that uses another C6 pin needs that firmware
            rebuilt (coprocessor/c6/update_prebuilt.sh).

    # The size of the Gateway relay ring and the capacity advertised in
    # AirPlay SETUP can be varied independently during buffering tests.
    config AIRPLAY_GW_RELAY_RING_KIB
        int
        depends on AIRPLAY_ROLE_GATEWAY
        default 8192 if IDF_TARGET_ESP32P4
        default 4096
    config AIRPLAY_GW_ADVERTISED_BUFFER_KIB
        int
        depends on AIRPLAY_ROLE_GATEWAY
        default 8192 if IDF_TARGET_ESP32P4
        default 6144

    config AIRPLAY_SURROUND_GATEWAY_HOST
        string "Gateway IPv4 address (empty = find it by mDNS)"
        default ""
        depends on AIRPLAY_ROLE_SPEAKER
        help
            A speaker finds the Gateway by mDNS
            (_apsurround._tcp). Set an IPv4 address here to skip the search,
            for example when mDNS is filtered on the network.

    config AIRPLAY_SURROUND_SYNC_PULSE
        bool "Sync test pulse at every second of sender time"
        default n
        select ESP_TIMER_SUPPORTS_ISR_DISPATCH_METHOD
        help
            For measuring synchronisation with an oscilloscope. The Gateway
            and every Surround speaker raise a GPIO at each whole second of
            the sender's clock, as each of them sees it (the Gateway from
            PTP, a speaker from the Gateway's TIME messages). The distance
            between the rising edges of two boards is their clock error.
            The edge comes from a hardware timer interrupt; the log reports
            how late each interrupt ran.

    config AIRPLAY_SURROUND_SYNC_PULSE_GPIO
        int "Sync test pulse GPIO"
        default 50 if IDF_TARGET_ESP32P4
        default 9
        range 0 SOC_GPIO_OUT_RANGE_MAX
        depends on AIRPLAY_SURROUND_SYNC_PULSE
        help
            Pick a free pin. ESP32-S3 (default 9): not used by the default
            I2S 4/5/6, amplifier 21, LED 38 or latency loopback 7; avoid the
            strapping pins 0, 3, 45, 46, USB 19/20 and the flash/PSRAM pins
            26-37. ESP32-P4 (default 50): 9 is the FireBeetle 2's onboard
            microphone.

    config AIRPLAY_SURROUND_CAL_MIC
        bool "Room calibration microphone on the Gateway"
        default y
        depends on AIRPLAY_ROLE_GATEWAY
        help
            A microphone on the Gateway, placed at the listening seat,
            measures every speaker's travel time and level from test chirps
            and suggests each speaker's delay and level (speakers page, Room
            calibration). The microphone runs only during a measurement;
            without one the page says there is no signal. Either an INMP441
            on I2S, or a PDM microphone such as the one on the FireBeetle 2
            ESP32-P4 board.

    choice AIRPLAY_SURROUND_CAL_MIC_TYPE
        prompt "Calibration microphone type"
        depends on AIRPLAY_SURROUND_CAL_MIC
        default AIRPLAY_SURROUND_CAL_MIC_PDM if AIRPLAY_GW_BOARD_FIREBEETLE_P4
        default AIRPLAY_SURROUND_CAL_MIC_INMP441
        config AIRPLAY_SURROUND_CAL_MIC_INMP441
            bool "INMP441 on I2S (SCK, WS, SD)"
            help
                Wiring: VDD to 3V3, GND and L/R to GND, SCK, WS and SD to the
                pins below.
        config AIRPLAY_SURROUND_CAL_MIC_PDM
            bool "PDM microphone (CLK, DATA): the FireBeetle 2 P4's onboard one"
            depends on SOC_I2S_SUPPORTS_PDM_RX
            help
                A PDM MEMS microphone, read through the I2S PDM-to-PCM filter
                (16-bit PCM). The FireBeetle 2 ESP32-P4 has one on the board:
                CLK GPIO12, DATA GPIO9 (DFRobot wiki).
    endchoice

    config AIRPLAY_SURROUND_CAL_MIC_PDM_CLK_GPIO
        int "PDM microphone CLK GPIO"
        default 12
        range 0 SOC_GPIO_OUT_RANGE_MAX
        depends on AIRPLAY_SURROUND_CAL_MIC_PDM

    config AIRPLAY_SURROUND_CAL_MIC_PDM_DATA_GPIO
        int "PDM microphone DATA GPIO"
        default 9
        range 0 SOC_GPIO_IN_RANGE_MAX
        depends on AIRPLAY_SURROUND_CAL_MIC_PDM

    config AIRPLAY_SURROUND_CAL_MIC_SCK_GPIO
        int "Calibration microphone SCK GPIO"
        default 5
        range 0 SOC_GPIO_OUT_RANGE_MAX
        depends on AIRPLAY_SURROUND_CAL_MIC_INMP441

    config AIRPLAY_SURROUND_CAL_MIC_WS_GPIO
        int "Calibration microphone WS GPIO"
        default 52 if IDF_TARGET_ESP32P4
        default 6
        range 0 SOC_GPIO_OUT_RANGE_MAX
        depends on AIRPLAY_SURROUND_CAL_MIC_INMP441
        help
            6 on the ESP32-S3. 52 on the ESP32-P4, where 6 carries the time
            pulse from the C6 (on the FireBeetle 2 the microphone then sits
            on 52, 4, 5, next to each other on the right header).

    config AIRPLAY_SURROUND_CAL_MIC_SD_GPIO
        int "Calibration microphone SD (data) GPIO"
        default 4
        range 0 SOC_GPIO_IN_RANGE_MAX
        depends on AIRPLAY_SURROUND_CAL_MIC_INMP441
endmenu

menu "AirPlay Receiver"
    config DEFAULT_AP_SSID
        string "Setup AP SSID"
        default "ESP32-AirPlay-Setup"
    config DEFAULT_AP_PASSWORD
        string "Setup AP password"
        default ""
    config DEFAULT_AP_CHANNEL
        int "Setup AP channel"
        default 1
        range 1 13
    config AIRPLAY_AAC_FDK_LIMITER
        bool "FDK PCM limiter (S32, lookahead compensated)"
        depends on AIRPLAY_ROLE_SPEAKER
        default y
        help
            Enable FDK peak limiting before the float DSP chain. Preserve S32
            output and compensate the 15 ms lookahead in PCM RTP tags.
            Pending samples are drained only for valid audio and discarded
            on FLUSH, stream, format or selected-speaker changes.
            Peaks introduced later by EQ or loudness are not limited here.

    config AIRPLAY_HOMEKIT
        bool "HomeKit: allow adding the Gateway speaker to Home"
        depends on AIRPLAY_ROLE_GATEWAY
        default y
        help
            Present the whole surround system as one AirPlay speaker in Apple
            Home, with pairing, artwork and playback controls. The individual
            speakers remain connected through the private surround protocol.
            AAC 5.1/7.1 support and speaker channel assignments are retained.

    config AIRPLAY_SENDER_TAKES_ON_PLAY
        bool "A second sender takes over only when it plays"
        depends on AIRPLAY_HOMEKIT
        default y
        help
            While one sender plays (an Apple TV), another one that connects
            (an iPhone opening Control Center) only listens: the first keeps
            playing and its volume stays; the second takes over when it starts
            playing. Off: it takes over as soon as it connects.

    config AIRPLAY_HOMEKIT_MANUFACTURER
        string "HomeKit manufacturer"
        depends on AIRPLAY_HOMEKIT
        default "Espressif"

    config AIRPLAY_HOMEKIT_SETUP_CODE
        string "HomeKit setup code"
        depends on AIRPLAY_HOMEKIT
        default "3939"
        help
            Setup code used by full HomeKit pairing. Transient AirPlay
            enrollment remains available for Apple Home speaker setup.

    config ENABLE_AIRPLAY_ARTWORK
        bool "Advertise artwork support"
        default y if AIRPLAY_ROLE_GATEWAY
        default n

    menu "Hardware playback buttons"
        config AIRPLAY_HARDWARE_BUTTONS
            bool "Enable GPIO playback buttons (PSRAM task)"
            depends on SPIRAM && FREERTOS_TASK_CREATE_ALLOW_EXT_MEM
            default n
            help
                Connect each momentary button between its GPIO and GND.
                Inputs use internal pull-ups and software debounce.
                Commands go through the existing AirPlay event worker.
                A low-priority polling task uses a 3072-byte stack in PSRAM;
                its control structure remains in internal RAM.
                No task is created if all GPIOs are -1.

                Use free GPIOs exposed by your board. Avoid flash/PSRAM,
                I2S, console, amplifier and LED pins. Strapping pins may
                change the boot mode if their button is held during reset.

        if AIRPLAY_HARDWARE_BUTTONS
            config AIRPLAY_BUTTON_PLAY_PAUSE_GPIO
                int "Play/Pause GPIO (-1 = disabled)"
                range -1 SOC_GPIO_IN_RANGE_MAX
                default -1
            config AIRPLAY_BUTTON_NEXT_GPIO
                int "Next GPIO (-1 = disabled)"
                range -1 SOC_GPIO_IN_RANGE_MAX
                default -1
            config AIRPLAY_BUTTON_PREVIOUS_GPIO
                int "Previous GPIO (-1 = disabled)"
                range -1 SOC_GPIO_IN_RANGE_MAX
                default -1
            config AIRPLAY_BUTTON_VOLUME_DOWN_GPIO
                int "Volume - GPIO (-1 = disabled)"
                range -1 SOC_GPIO_IN_RANGE_MAX
                default -1
            config AIRPLAY_BUTTON_VOLUME_UP_GPIO
                int "Volume + GPIO (-1 = disabled)"
                range -1 SOC_GPIO_IN_RANGE_MAX
                default -1
            config AIRPLAY_BUTTON_DEBOUNCE_MS
                int "Button debounce (milliseconds)"
                range 10 200
                default 30
                help
                    Both press and release must stay stable for this long.
                    Sends one command per press. Holding a button does not
                    repeat commands. A button held at boot is ignored until
                    released and pressed again. A busy or disconnected
                    AirPlay command is logged and dropped, never retried.
        endif
    endmenu

    config AIRPLAY_MODEL_ID
        string "AirPlay model identifier"
        default "AirPlaySpeaker1,1" if AIRPLAY_HOMEKIT
        default "AudioAccessory6,1"
        help
            The model this receiver announces to AirPlay senders (mDNS
            "model"/"am" and GET /info). The sender picks the icon it
            shows from it. AudioAccessory6,1 = HomePod (2nd generation),
            the HomePod icon. A name Apple does not know gives a generic
            speaker icon. Changing it may change how a sender treats the
            receiver: check that 5.1 / 7.1 still arrives.
endmenu

menu "Multichannel Experiment"

    config AIRPLAY_MULTICHANNEL
        bool "Receive 5.1/7.1 AAC and play one channel"
        default y
        help
            EXPERIMENT. Also advertise AAC-LC 48 kHz 5.1 and 7.1 for buffered
            audio and play a single channel of such a stream on both I2S
            slots (decoded with Fraunhofer FDK AAC). Stereo AAC and realtime
            (type 96) ALAC still play normally. Buffered stereo supports
            AAC at 44.1/48 kHz and ALAC at 44.1 kHz/16-bit or 48 kHz/24-bit.
            I2S follows the input rate, with a short silence at each switch.

    choice AIRPLAY_MULTICHANNEL_SPEAKER
        prompt "Default speaker this speaker plays"
        depends on AIRPLAY_MULTICHANNEL
        default AIRPLAY_MC_SPEAKER_L
        help
            Which speaker of the 5.1/7.1 stream goes to this speaker's
            output (the same signal on both I2S slots, L = R). This is only
            the default: the Gateway's Speakers page (Role) changes it live
            and the speaker remembers the choice across reboots.

            The speaker is found by name, not by a fixed channel number, so
            the same setting works for 5.1 and 7.1. For 7.1, Apple TV sends
            AAC channel configuration 7: C, pair, pair, pair, LFE. The names
            below follow the 7.1 order C L R Ls Rs Lrs Rrs LFE (Apple's
            AAC_7_1_B; FFmpeg and other receivers read configuration 7 the
            same way); the ISO reading of configuration 7 would instead call
            the first pair "front centre" and the second pair L/R. Check
            with a 7.1 speaker test; if Front L/R and Side L/R come out
            swapped, that is why.

            Typical 7.1 placement (listener in the middle, facing the TV):
              Front L/R  ~ 30 deg left/right of the screen
              Centre     under/over the screen
              Side L/R   ~ 90-110 deg, beside the listener
              Rear L/R   ~ 135-150 deg, behind the listener
              LFE        subwoofer (low-frequency effects, < ~120 Hz)
            Every channel plays only on its own speaker: with 5.1 the stream
            has no rear channels, so Rear L/R are silent; with 7.1 and no
            rear speakers the rear channels are not heard.

        config AIRPLAY_MC_SPEAKER_L
            bool "Front Left (L)"
            help
                Main left speaker, ~30 deg left of the screen. In a 7.1
                stream from Apple TV: the first channel pair, left.
        config AIRPLAY_MC_SPEAKER_R
            bool "Front Right (R)"
            help
                Main right speaker, ~30 deg right of the screen.
        config AIRPLAY_MC_SPEAKER_C
            bool "Centre (C)"
            help
                Centre speaker under or over the screen; carries most
                dialogue.
        config AIRPLAY_MC_SPEAKER_LFE
            bool "Subwoofer (LFE)"
            help
                Low-frequency effects channel for a subwoofer. It contains
                only the extra bass effects, not the bass of the other
                speakers.
        config AIRPLAY_MC_SPEAKER_LS
            bool "Side Left (Ls)"
            help
                Left surround, beside the listener (~90-110 deg). In 5.1
                this is the (only) left surround speaker.
        config AIRPLAY_MC_SPEAKER_RS
            bool "Side Right (Rs)"
            help
                Right surround, beside the listener (~90-110 deg).
        config AIRPLAY_MC_SPEAKER_LRS
            bool "Rear Left (Lrs)"
            help
                Left rear surround, behind the listener (~135-150 deg).
                7.1 only; a 5.1 stream plays Side Left here.
        config AIRPLAY_MC_SPEAKER_RRS
            bool "Rear Right (Rrs)"
            help
                Right rear surround, behind the listener (~135-150 deg).
                7.1 only; a 5.1 stream plays Side Right here.
        config AIRPLAY_MC_SPEAKER_MIX
            bool "Mono mix of all speakers (no LFE)"
            help
                Every channel except LFE folded into one mono signal. Costs
                the most CPU: all channels must be fully decoded.
    endchoice

    config AIRPLAY_MULTICHANNEL_DEFAULT_SPEAKER
        int
        depends on AIRPLAY_MULTICHANNEL
        default 0 if AIRPLAY_MC_SPEAKER_L
        default 1 if AIRPLAY_MC_SPEAKER_R
        default 2 if AIRPLAY_MC_SPEAKER_C
        default 3 if AIRPLAY_MC_SPEAKER_LFE
        default 4 if AIRPLAY_MC_SPEAKER_LS
        default 5 if AIRPLAY_MC_SPEAKER_RS
        default 6 if AIRPLAY_MC_SPEAKER_LRS
        default 7 if AIRPLAY_MC_SPEAKER_RRS
        default -1

endmenu

menu "Amplifier Power Control"
    config AIRPLAY_AMP_CONTROL
        bool "Enable amplifier power control GPIO"
        default y
        help
            Drive an amplifier enable/standby GPIO from a dedicated low-priority
            task. RTSP code only updates the session state and wakes that task;
            GPIO access and the delayed power-off never run in the audio/RTSP path.

    config AIRPLAY_AMP_GPIO
        int "Amplifier control GPIO"
        default 21
        range 0 SOC_GPIO_OUT_RANGE_MAX
        depends on AIRPLAY_AMP_CONTROL

    choice AIRPLAY_AMP_ACTIVE_LEVEL
        prompt "Amplifier GPIO active level"
        default AIRPLAY_AMP_ACTIVE_HIGH
        depends on AIRPLAY_AMP_CONTROL

        config AIRPLAY_AMP_ACTIVE_HIGH
            bool "Active HIGH"

        config AIRPLAY_AMP_ACTIVE_LOW
            bool "Active LOW"
    endchoice

    config AIRPLAY_AMP_OFF_DELAY_SEC
        int "Amplifier power-off delay after AirPlay disconnect (seconds)"
        default 300
        range 0 3600
        depends on AIRPLAY_AMP_CONTROL
        help
            The amplifier remains enabled while at least one AirPlay control
            session is active. After the last session disconnects, the amp task
            waits this long before switching the GPIO inactive. A reconnect
            during the delay keeps the amplifier on.
endmenu

menu "AirPlay Logs and Diagnostics"
    comment "Every option is compiled out completely when off"

    config AIRPLAY_LOG_RUNTIME
        bool "Runtime event logs (RTSP, PTP, audio path, modules)"
        default n
        help
            Logs written while the receiver runs: RTSP requests handled
            (SETUP, FLUSH, SETRATEANCHORTIME, TEARDOWN...), play lock and
            connections, PTP clock events, AAC/ALAC stream events, FIFO,
            decoder warnings, LED/amplifier/buttons, Wi-Fi retries, web UI
            actions.
            When off, these calls are not compiled at all, so no running
            RTSP/PTP/audio function spends time formatting or printing them.
            Start-up messages, NOW PLAYING format/speaker warnings, the
            2-second audio_status line, SERVO CENTER and all errors are
            always logged.

    config AIRPLAY_LOG_AUDIO_EVENTS
        bool "Log every audible audio event (I2S stop/start, silence, mutes)"
        default n
        help
            Prints one "AUDIO EVT" line, with its time since boot, for each
            event that can be heard as a click, pop or gap: the I2S clocks
            stopping (with the reason) and starting again, a whole DMA block
            played as silence, a hole in a block filled with silence, an AAC
            block muted or lost, an ALAC block played as silence, and every
            I2S clock retune. The playout task only posts numbers; the
            low-priority status task prints them. Events are rare, so the
            cost is negligible. Turn off once the click source is found.

    config AIRPLAY_LOG_METADATA
        bool "Log track metadata (title, artist, album) and progress"
        default n
        help
            Prints "Now playing" (title and artist, then album and genre)
            whenever the sender changes the track metadata, and "Progress:
            position / duration" when it sends the play position. Only
            logged, never used by playback. Not compiled when off.

    config AIRPLAY_LOG_RTSP_REQUESTS
        bool "Log every RTSP request and reply"
        default n
        help
            One line per request (method, path, CSeq, body length) and per
            reply (code, body length), and the first bytes of each request
            body as text, except the bodies of SETUP, /pair-setup,
            /pair-verify and /fp-setup. A sender posts /feedback every 2 s.
            Used to see what the sender sends, for example around an AutoMix
            transition or a pause. Not compiled when off.

    config AIRPLAY_DIAG_PLAYOUT
        bool "Playout diagnostics (DMA underruns, holes, silence, re-primes)"
        default n
        help
            Checks playout every 2 seconds and prints a "PLAYOUT |" warning
            only for counted DMA underruns, tag faults, PCM holes, silent
            blocks, re-primes or silence inserted into PCM FIFO gaps.
            Includes maximum DMA write gap and block processing time as
            context; timing alone does not trigger a warning.

    config AIRPLAY_DIAG_LIFECYCLE
        bool "Task and session lifecycle diagnostics"
        default n
        help
            Logs each audio task start (core, priority) and realtime
            session stop/epoch changes.

    config AIRPLAY_DIAG_AUTOMIX
        bool "AutoMix / buffered stream continuity diagnostics"
        default n
        help
            For buffered (AAC) audio, logs every RTP timestamp discontinuity
            with the sequence numbers around it (does the sender skip
            packets or only jump the timeline?), blocks dropped as too old,
            blocks the PCM FIFO refused, and the active FLUSH state. Used to
            find the cause of silences during AutoMix transitions.

    config AIRPLAY_DIAG_ACTIVE
        bool
        default y if AIRPLAY_DIAG_PLAYOUT || AIRPLAY_DIAG_LIFECYCLE
        default n
endmenu

menu "I2S Playout"
    config I2S_SCK_IO
        int "I2S MCLK GPIO (-1 = not used)"
        default -1
        help
            MCLK output for DACs that need a master clock. -1 leaves it
            unconnected (PCM5102A and most DACs make their own clock from
            BCLK). The suggested pin, when a DAC needs it, is GPIO 2.
    config I2S_BCK_IO
        int "I2S BCLK GPIO"
        default 5
    config I2S_WS_IO
        int "I2S LRCK/WS GPIO"
        default 6
    config I2S_DO_IO
        int "I2S DATA OUT GPIO"
        default 4

    config AIRPLAY_I2S_KEEP_RUNNING
        bool "Keep I2S running (zeros) on pause, seek and track change"
        default y
        help
            On pause, FLUSH, seek and next/previous track the audio already
            queued fades out (~60 ms), the I2S clocks keep running and the DAC
            gets digital silence (zeros) until playback resumes; the next
            start is aligned on the running clocks. Most DACs like this best:
            no lost lock, no relock pop. Every start after a stop fades in
            (~87 ms) in both modes; a running stream (gapless, AutoMix) is
            never faded.
            I2S is still stopped at a session end, a codec change and after a
            DMA fault.
            Turn it off if your DAC pops or clicks with it, or needs the
            clocks to stop to go to standby: then I2S stops on every pause.

    config AIRPLAY_OUTPUT_LATENCY_US
        int "Default output latency after the ESP (microseconds)"
        default 0
        range -100000 150000
        help
            Delay added by the hardware after the ESP I2S output (DAC digital
            filter, DSP, digital-input amplifier). The ESP plays this much
            earlier so the sound leaves the speaker on time in multiroom.
            Typical: PCM5102A ~450, DSP with a linear-phase FIR = half its
            length (1024 taps @48 kHz ~10700). The web UI can override it and
            the wired measurement saves the real value; this is only the
            default when nothing has been saved.

    config AIRPLAY_LATENCY_CAL
        bool "Enable wired output-latency measurement (ADC loopback)"
        default y
        help
            Adds a "Measure" button to the web UI. With a wire (through a
            coupling capacitor and bias divider) from the DAC/DSP line output
            to the ADC pin below, the ESP plays short test chirps and measures
            the real output latency. Uses nothing until the button is pressed.

    config AIRPLAY_LATENCY_CAL_GPIO
        int "Loopback ADC input GPIO (ADC1: 1-10)"
        default 7
        range 1 10
        depends on AIRPLAY_LATENCY_CAL

    config AIRPLAY_WEB_ADMIN_PASSWORD
        string "Web UI admin password (empty = no password)"
        default ""
        help
            When set, firmware update, restart, Wi-Fi / device name changes and
            the latency test in the web UI require HTTP Basic authentication
            with user "admin" and this password. Leave empty to keep the web
            UI open (default).
endmenu

menu "RGB Audio/VU LED"
    config ENABLE_RGB_AUDIO_LED
        bool "Enable WS2812 RGB audio/VU LED"
        default n if AIRPLAY_GW_BOARD_FIREBEETLE_P4
        default y
        help
            One WS2812 RGB LED shows the AirPlay state and, while playing, a
            level meter of the audio sent to I2S (components/led). Disable it
            to remove the LED and its work from the audio path.

    config RGB_AUDIO_LED_GPIO
        int "WS2812 data GPIO"
        default 33 if IDF_TARGET_ESP32P4
        default 38
        range 0 SOC_GPIO_OUT_RANGE_MAX
        depends on ENABLE_RGB_AUDIO_LED
        help
            GPIO connected to the WS2812 data input. Use 38 on the current
            board; boards with an onboard RGB LED often use GPIO 48.

    config RGB_AUDIO_LED_BRIGHTNESS
        int "Maximum RGB brightness (0-255)"
        default 96
        range 0 255
        depends on ENABLE_RGB_AUDIO_LED

    config RGB_AUDIO_LED_UPDATE_HZ
        int "VU refresh rate (Hz)"
        default 30
        range 5 60
        depends on ENABLE_RGB_AUDIO_LED
        help
            How often the level meter is computed and the LED written while
            playing. About 30 Hz gives a smooth meter.

    choice RGB_AUDIO_LED_PLAYING_MODE
        prompt "LED mode while playing"
        default RGB_AUDIO_LED_PLAYING_VU
        depends on ENABLE_RGB_AUDIO_LED
        config RGB_AUDIO_LED_PLAYING_VU
            bool "VU / color music"
        config RGB_AUDIO_LED_PLAYING_STEADY
            bool "Steady green"
        config RGB_AUDIO_LED_PLAYING_OFF
            bool "Off"
    endchoice

    choice RGB_AUDIO_LED_PAUSED_MODE
        prompt "LED mode while paused/connected"
        default RGB_AUDIO_LED_PAUSED_STEADY
        depends on ENABLE_RGB_AUDIO_LED
        config RGB_AUDIO_LED_PAUSED_STEADY
            bool "Steady blue"
        config RGB_AUDIO_LED_PAUSED_OFF
            bool "Off"
    endchoice

    choice RGB_AUDIO_LED_STANDBY_MODE
        prompt "LED mode while disconnected/standby"
        default RGB_AUDIO_LED_STANDBY_OFF
        depends on ENABLE_RGB_AUDIO_LED
        config RGB_AUDIO_LED_STANDBY_OFF
            bool "Off"
        config RGB_AUDIO_LED_STANDBY_STEADY
            bool "Steady dim green"
    endchoice
endmenu

menu "USB Player (experimental)"

    config AIRPLAY_SURROUND_PLAYER_STREAMS
        bool "Player streams: one channel per speaker (ALAC)"
        default y
        help
            ROADMAP_USB_PLAYER.md, phase 1. Speaker: also takes the
            Gateway player's lane formats (common/surround/
            surround_player_formats.h): ALAC 44.1/48 kHz, 16/24 bit, one
            channel, written to both output slots, so the stereo route, EQ
            and bi-amp see what a LEFT/RIGHT route gives today. Apple and
            radio streams are untouched. Off: those SSRCs are skipped as
            unknown, as today.

    config GATEWAY_USB_PLAYER
        bool "Gateway player (FLAC, WAV, ALAC, AAC, MP3 over HTTP)"
        depends on AIRPLAY_ROLE_GATEWAY && AIRPLAY_SURROUND_PLAYER_STREAMS
        default y
        help
            The Gateway plays music files of its own (FLAC, WAV, ALAC,
            AAC, MP3, m3u playlists; README: USB player) to the speakers,
            one lane per role in the relay's lane mode: L and R bit for
            bit, the subwoofer and a mono mix 0.5 * (L + R) as 24 bit, a
            5.1/7.1 file's channels each on its own speaker. The page's
            player bar and GET/POST /api/player control it. The speakers
            need Player streams. Experimental; on by default.

    config GATEWAY_USB_PLAYER_USB
        bool "Gateway player: a USB drive"
        depends on GATEWAY_USB_PLAYER && (IDF_TARGET_ESP32P4 || (!ESP_CONSOLE_USB_SERIAL_JTAG && !ESP_CONSOLE_SECONDARY_USB_SERIAL_JTAG))
        select GATEWAY_USB_PLAYER_USB_COMPONENTS
        default y
        help
            Mount a FAT32 drive at /usb and play files from it. On the P4
            use the dedicated high-speed USB OTG port. On the S3 use the
            native USB port (GPIO19/20) and move the console to UART0.
            The drive needs 5 V. Set FAT Filesystem support -> API character
            encoding to UTF-8 for UTF-8 names.

    config GATEWAY_USB_PLAYER_USB_COMPONENTS
        bool "Fetch the USB host components (the USB drive turns this on)"
        default n
        help
            espressif/usb and usb_host_msc for the USB drive
            (main/idf_component.yml). The component manager only reads
            options that are always in sdkconfig, so this one has a prompt;
            "Gateway player: a USB drive" selects it. Leave it to that.

    config GATEWAY_PLAYER_TEST_RADIO_ONE_CHANNEL
        bool "Test: the web radio sends one channel to all speakers"
        depends on AIRPLAY_ROLE_GATEWAY && AIRPLAY_SURROUND_PLAYER_STREAMS
        default n
        help
            Phase 1 test only. Instead of stereo ALAC the web radio sends
            one channel, 0.5 * (L + R), in the player's lane format to
            every speaker (the format announced stays the radio's stereo
            one). Each speaker plays it in both slots: L, R and the
            subwoofer hear the same mono signal, centre and surrounds stay
            silent as with any stereo source. Needs speakers built with
            AIRPLAY_SURROUND_PLAYER_STREAMS. Leave off.

    config GATEWAY_PLAYER_TEST_RADIO_LANES
        bool "Test: the web radio sends one lane per speaker role"
        depends on AIRPLAY_ROLE_GATEWAY && AIRPLAY_SURROUND_PLAYER_STREAMS && !GATEWAY_PLAYER_TEST_RADIO_ONE_CHANNEL
        default n
        help
            Phase 2 test only. The web radio goes out in the relay's lane
            mode, as the player will send: four lanes with the same seq
            and RTP time, L to the left speaker and R to the right one bit
            for bit, 0.5 * (L + R) as 24 bit to the subwoofer and to a mono
            mix speaker. Each speaker gets only its own lane. Needs speakers
            built with AIRPLAY_SURROUND_PLAYER_STREAMS. Leave off.

    config GATEWAY_PLAYER_TEST_RADIO_MULTICHANNEL
        bool "Test: mark that channel as one of a 5.1/7.1 file"
        depends on GATEWAY_PLAYER_TEST_RADIO_ONE_CHANNEL
        default n
        help
            Phase 1 test only. The radio's one channel goes out as a lane of
            a 5.1/7.1 file: the speakers skip their stereo route (centre and
            surrounds play it too) and the subwoofer applies its LFE gain,
            as with a 5.1/7.1 AAC stream. Leave off.

    config GATEWAY_PLAYER_BENCH
        bool "ALAC encoder bench at boot (measurements only)"
        depends on AIRPLAY_ROLE_GATEWAY
        default n
        help
            Phase 0 of ROADMAP_USB_PLAYER.md. About 20 s after boot one task
            on Core 0 times the ALAC encoder (mono, 44.1/16, 48/16, 48/24,
            fast_mode on and off, one and eight encoders), logs the encoder's
            cookie, bytesShifted and a bit-exact decode round trip, then the
            same for a light mono ALAC encoder of the bench (phase 0b), all
            as "BENCH" log lines, and ends. Nothing else changes. Leave off.
endmenu
```
